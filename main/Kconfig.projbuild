## main/Kconfig.projbuild
```kconfig
menu "wiscosat"

config SAT_DEV
    bool "A dev build (adds the command download)"
    default n
    help
        A dev build is made by ./build --dev into out-dev/ (sdkconfig.dev sets this), never by a flag on the
        release image in out/. It adds the command download (restart into the ROM's download mode, for esptool
        with no buttons), says "dev": true in status, and its version ends in -dev. Only a unit kept for
        development runs one.

config SAT_BROKEN
    bool "A broken dev build, for the rollback check (a wrong Wi-Fi name over the settings)"
    depends on SAT_DEV
    default n
    help
        Made by ./build --dev --broken into out-broken/ (sdkconfig.broken sets this) and nowhere else. The image
        joins a Wi-Fi of a name no network has, so after an update it cannot prove itself and the bootloader takes
        the old image back 120 s after its start. A test of the rollback only.

choice SAT_LED
    prompt "The LED identify blinks"
    default SAT_LED_APA102
    help
        identify blinks this LED for 5 s. none: identify answers "no led on this board".

config SAT_LED_APA102
    bool "A ring of APA102 LEDs (LilyGO T-Embed: 7, data GPIO 42, clock GPIO 45)"
config SAT_LED_NONE
    bool "none"
endchoice

config SAT_LED_APA102_DATA
    int "APA102 data GPIO"
    depends on SAT_LED_APA102
    default 42
config SAT_LED_APA102_CLOCK
    int "APA102 clock GPIO"
    depends on SAT_LED_APA102
    default 45
config SAT_LED_APA102_COUNT
    int "APA102 LEDs in the chain"
    depends on SAT_LED_APA102
    default 7

choice SAT_SCREEN
    prompt "The screen that shows the unit's name"
    default SAT_SCREEN_ST7789
    help
        The unit's name, large, and its address and version below, drawn once after USB has started. none: a board
        with no screen.

config SAT_SCREEN_ST7789
    bool "An ST7789 on SPI (LilyGO T-Embed: 320x170, MOSI 11, SCLK 12, CS 10, DC 13, RST 9, backlight 15)"
config SAT_SCREEN_NONE
    bool "none"
endchoice

config SAT_SCREEN_MOSI
    int "Screen MOSI GPIO"
    depends on SAT_SCREEN_ST7789
    default 11
config SAT_SCREEN_SCLK
    int "Screen SCLK GPIO"
    depends on SAT_SCREEN_ST7789
    default 12
config SAT_SCREEN_CS
    int "Screen CS GPIO"
    depends on SAT_SCREEN_ST7789
    default 10
config SAT_SCREEN_DC
    int "Screen DC GPIO"
    depends on SAT_SCREEN_ST7789
    default 13
config SAT_SCREEN_RST
    int "Screen reset GPIO"
    depends on SAT_SCREEN_ST7789
    default 9
config SAT_SCREEN_BL
    int "Screen backlight GPIO"
    depends on SAT_SCREEN_ST7789
    default 15
config SAT_SCREEN_WIDTH
    int "Screen width in landscape"
    depends on SAT_SCREEN_ST7789
    default 320
config SAT_SCREEN_HEIGHT
    int "Screen height in landscape"
    depends on SAT_SCREEN_ST7789
    default 170
config SAT_SCREEN_GAP
    int "Rows of the controller's RAM before the panel's first (a 170-row panel on a 240-row ST7789: 35)"
    depends on SAT_SCREEN_ST7789
    default 35
config SAT_SCREEN_FLIP
    bool "Turn the picture by 180 degrees"
    depends on SAT_SCREEN_ST7789
    default n
config SAT_SCREEN_BRIGHTNESS
    int "Backlight, percent (dim by default: seen, not a lamp)"
    depends on SAT_SCREEN_ST7789
    range 1 100
    default 20

choice SAT_KNOB
    prompt "The knob that picks a key"
    default SAT_KNOB_ENCODER
    help
        Turning walks a list on the screen (keys to arm for the next start, combinations to send now); a press
        acts. none: a board with no knob.

config SAT_KNOB_ENCODER
    bool "A rotary encoder with a push button (LilyGO T-Embed: A GPIO 2, B GPIO 1, button GPIO 0)"
    depends on SAT_SCREEN_ST7789
config SAT_KNOB_NONE
    bool "none"
endchoice

config SAT_KNOB_A
    int "Encoder A GPIO"
    depends on SAT_KNOB_ENCODER
    default 2
config SAT_KNOB_B
    int "Encoder B GPIO"
    depends on SAT_KNOB_ENCODER
    default 1
config SAT_KNOB_BUTTON
    int "Encoder button GPIO (low when pressed)"
    depends on SAT_KNOB_ENCODER
    default 0
config SAT_KNOB_REVERSE
    bool "Turn the list the other way"
    depends on SAT_KNOB_ENCODER
    default n

choice SAT_BATTERY
    prompt "The battery whose voltage status shows"
    default SAT_BATTERY_ADC
    help
        status's battery: its voltage in mV and whether that is USB power (usb_power), read through a divider on
        an ADC pin when status asks. none: a board with no battery (status says "battery": null).

config SAT_BATTERY_ADC
    bool "A divider on an ADC pin (LilyGO T-Embed: GPIO 4, 100k and 100k, behind GPIO 46's switch)"
config SAT_BATTERY_NONE
    bool "none"
endchoice

config SAT_BATTERY_GPIO
    int "Battery ADC GPIO"
    depends on SAT_BATTERY_ADC
    default 4
config SAT_BATTERY_DIVIDER
    int "The battery's voltage over the pin's (the divider's ratio)"
    depends on SAT_BATTERY_ADC
    default 2
config SAT_BATTERY_USB_MV
    int "A reading at or over this (mV) is USB power, not the battery"
    depends on SAT_BATTERY_ADC
    default 4400
    help
        The T-Embed's pin reads its supply rail: USB through a Schottky diode with a cable in (about 4700 mV), the
        battery with it out (a Li-ion cell holds 4200 at most). status's battery says usb_power from this line.
config SAT_BATTERY_FLOOR_MV
    int "A reading under this (mV) is no supply: the pin is wired to no battery"
    depends on SAT_BATTERY_ADC
    default 3000
    help
        No running board's rail is this low (it would have browned out), so a pin reading under it is wired to
        nothing that powers the board (a board with no battery circuit): status's battery says usb_power null and a
        fault, and nothing about the cable.

endmenu
```
